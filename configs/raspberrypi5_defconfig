## configs/raspberrypi5_defconfig
```kconfig
# Architecture
BR2_aarch64=y
BR2_ARM_FPU_VFPV4=y

# Toolchain
BR2_TOOLCHAIN_BUILDROOT_GLIBC=y
BR2_GCC_VERSION_12_X=y
BR2_BINUTILS_VERSION_2_40_X=y
BR2_GLIBC_VERSION_2_37=y

# System
BR2_TARGET_GENERIC_HOSTNAME="music-os"
BR2_TARGET_GENERIC_ISSUE="Welcome to Custom Music OS"
BR2_TARGET_GENERIC_ROOT_PASSWD=""
BR2_TARGET_GENERIC_GETTY_PORT="tty1"
BR2_TARGET_GENERIC_GETTY_BAUDRATE_115200=y

# Init system
BR2_INIT_SYSTEMD=y
BR2_SYSTEMD_DISABLE_RESOLVED=y

# Linux kernel
BR2_LINUX_KERNEL=y
BR2_LINUX_KERNEL_CUSTOM_VERSION=y
BR2_LINUX_KERNEL_CUSTOM_VERSION_VALUE="6.1.69"
BR2_LINUX_KERNEL_USE_CUSTOM_CONFIG=y
BR2_LINUX_KERNEL_CUSTOM_CONFIG_FILE="board/custom/music-os/linux-pi5.config"
BR2_LINUX_KERNEL_CONFIG_FRAGMENT_FILES=""

# Bootloader
BR2_TARGET_UBOOT=y
BR2_TARGET_UBOOT_CUSTOM_VERSION=y
BR2_TARGET_UBOOT_CUSTOM_VERSION_VALUE="2023.10"
BR2_TARGET_UBOOT_BOARD_DEFCONFIG="rpi_5_arm64"
BR2_TARGET_UBOOT_CONFIG_FRAGMENT_FILES=""

# Filesystem
BR2_TARGET_ROOTFS_SQUASHFS=y
BR2_TARGET_ROOTFS_TAR_GZIP=y

# Packages
BR2_PACKAGE_BUSYBOX=y
BR2_PACKAGE_DROPBEAR=y
BR2_PACKAGE_WPA_SUPPLICANT=y
BR2_PACKAGE_DHCPCD=y
BR2_PACKAGE_ALSA_UTILS=y
BR2_PACKAGE_MPD=y
BR2_PACKAGE_MPV=y
BR2_PACKAGE_FFMPEG=y
BR2_PACKAGE_YT_DLP=y
BR2_PACKAGE_PYTHON3=y
BR2_PACKAGE_PYTHON_PILLOW=y
BR2_PACKAGE_PYTHON_MUTAGEN=y
BR2_PACKAGE_PYTHON_REQUESTS=y
BR2_PACKAGE_PYTHON_TKINTER=y

# Development tools
BR2_PACKAGE_GDB=y
BR2_PACKAGE_STRACE=y
BR2_PACKAGE_HTOP=y

# Network
BR2_PACKAGE_IPROUTE2=y
BR2_PACKAGE_IPTABLES=y

# Overlay
BR2_ROOTFS_OVERLAY="board/custom/music-os/overlay" 
```

## legacy/configs/vmware_defconfig
```kconfig
# Architecture
BR2_x86_64=y

# Toolchain
BR2_TOOLCHAIN_BUILDROOT_GLIBC=y
BR2_GCC_VERSION_12_X=y
BR2_BINUTILS_VERSION_2_40_X=y
BR2_GLIBC_VERSION_2_37=y

# System
BR2_TARGET_GENERIC_HOSTNAME="music-os"
BR2_TARGET_GENERIC_ISSUE="Welcome to Custom Music OS"
BR2_TARGET_GENERIC_ROOT_PASSWD=""
BR2_TARGET_GENERIC_GETTY_PORT="tty1"
BR2_TARGET_GENERIC_GETTY_BAUDRATE_115200=y

# Init system
BR2_INIT_SYSTEMD=y
BR2_SYSTEMD_DISABLE_RESOLVED=y

# Linux kernel
BR2_LINUX_KERNEL=y
BR2_LINUX_KERNEL_CUSTOM_VERSION=y
BR2_LINUX_KERNEL_CUSTOM_VERSION_VALUE="6.1.69"
BR2_LINUX_KERNEL_USE_CUSTOM_CONFIG=y
BR2_LINUX_KERNEL_CUSTOM_CONFIG_FILE="board/custom/music-os/linux-vmware.config"
BR2_LINUX_KERNEL_CONFIG_FRAGMENT_FILES=""

# Filesystem
BR2_TARGET_ROOTFS_SQUASHFS=y
BR2_TARGET_ROOTFS_TAR_GZIP=y

# VMware-specific packages
BR2_PACKAGE_BUSYBOX=y
BR2_PACKAGE_DROPBEAR=y
BR2_PACKAGE_WPA_SUPPLICANT=y
BR2_PACKAGE_DHCPCD=y
BR2_PACKAGE_ALSA_UTILS=y
BR2_PACKAGE_MPD=y
BR2_PACKAGE_MPV=y
BR2_PACKAGE_FFMPEG=y
BR2_PACKAGE_YT_DLP=y
BR2_PACKAGE_PYTHON3=y
BR2_PACKAGE_PYTHON_PILLOW=y
BR2_PACKAGE_PYTHON_MUTAGEN=y
BR2_PACKAGE_PYTHON_REQUESTS=y
BR2_PACKAGE_PYTHON_TKINTER=y

# VMware Tools (optional)
BR2_PACKAGE_OPEN_VM_TOOLS=y

# Development tools
BR2_PACKAGE_GDB=y
BR2_PACKAGE_STRACE=y
BR2_PACKAGE_HTOP=y

# Network
BR2_PACKAGE_IPROUTE2=y
BR2_PACKAGE_IPTABLES=y

# VMware-specific optimizations
BR2_PACKAGE_LINUX_TOOLS_PERF=y
BR2_PACKAGE_LINUX_TOOLS_SELFTESTS=y

# Overlay
BR2_ROOTFS_OVERLAY="board/custom/music-os/overlay" 
```
